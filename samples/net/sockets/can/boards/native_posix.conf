## samples/net/sockets/can/boards/native_posix.conf
```kconfig
CONFIG_CAN_NATIVE_POSIX=y
CONFIG_ETH_NATIVE_POSIX=n

CONFIG_CAN=y
CONFIG_CAN_MAX_FILTER=5

CONFIG_NETWORKING=y
CONFIG_CAN_NATIVE_POSIX=y
CONFIG_CAN_NATIVE_POSIX_INTERFACE_1_ENABLE=y
CONFIG_CAN_NATIVE_POSIX_INTERFACE_2_ENABLE=y
CONFIG_CAN_NATIVE_POSIX_INTERFACE_1_NAME="vcan0"
CONFIG_CAN_NATIVE_POSIX_INTERFACE_2_NAME="vcan1"

CONFIG_NET_SOCKETS=y
CONFIG_NET_SOCKETS_CAN=y
CONFIG_NET_SOCKETS_POSIX_NAMES=y

# CONFIG_CAN_NET=y
# CONFIG_NET_L2_CANBUS=y

CONFIG_NET_SOCKETS_CAN_RECEIVERS=4
```
